## modules/zmk-behavior-turbo/Kconfig
```kconfig
DT_COMPAT_ZMK_BEHAVIOR_TURBO_KEY := zmk,behavior-turbo-key

config ZMK_BEHAVIOR_TURBO_KEY
	bool
	default $(dt_compat_enabled,$(DT_COMPAT_ZMK_BEHAVIOR_TURBO_KEY))

config ZMK_BEHAVIOR_TURBO_KEY_MAX_HELD
	int "Maximum simultaneous turbo keys"
	default 4
	depends on ZMK_BEHAVIOR_TURBO_KEY
```

## modules/zmk-behavior-turbo/dts/bindings/behaviors/zmk,behavior-turbo-key.yaml
```yaml
# Copyright (c) 2026
# SPDX-License-Identifier: MIT

description: >
  Turbo / auto-fire: while held, repeatedly press and release a keycode.
  Stops immediately when released. Delays can be fixed or random within a range.

compatible: "zmk,behavior-turbo-key"

include: one_param.yaml

properties:
  tap-ms-min:
    type: int
    default: 20
    description: Minimum duration of each synthetic key press (ms)
  tap-ms-max:
    type: int
    default: 20
    description: >
      Maximum duration of each synthetic key press (ms).
      If equal to tap-ms-min, press length is fixed.
  wait-ms-min:
    type: int
    default: 50
    description: Minimum gap between releasing a key and the next press (ms)
  wait-ms-max:
    type: int
    default: 50
    description: >
      Maximum gap between releasing a key and the next press (ms).
      If equal to wait-ms-min, the gap is fixed. If greater, each gap is random in [min, max].
```
